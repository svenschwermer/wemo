## package/WeMo_NetCam/Config.in
```kconfig
# NetCam configuration
choice
     prompt "Netcam version selection"
     depends on PACKAGE_WeMo_NetCam

     config NETCAM_NetCam
     	    bool "Netcam SD support"
	    help
		NetCam SD version support
	    default y
	   
     config NETCAM_HD_V1
     	    bool "Netcam HD Version 1 support"
	    help
		Netcam HD version 1 support
	    default n

      config NETCAM_HD_V2
            bool "NetCam HD Version 2 support"
	    help
		Netcam HD Version 2 support
	    default n

       config NETCAM_LS
       	     bool "NetCam Linksys support"
	     help
		NetCam Linksys support
	     default n
endchoice
```

## package/hal/kmod-wemo-gpio/Config.in
```kconfig
if PACKAGE_kmod-wemo-gpio

choice
       prompt "Belkin GPIO type"
       default WEMO_GPIO_SNS

config WEMO_GPIO_SNS
       bool "WeMo Switch and Sensor"

config WEMO_GPIO_BABYMON
       bool "WeMo Baby Monitor"

config WEMO_GPIO_INSIGHT
       bool "WeMo Insight Switch"

config WEMO_GPIO_GUARDIAN
       bool "WeMo Guardian"

config WEMO_GPIO_CROCKPOT
       bool "WeMo CrockPot"

endchoice

endif
```

## package/hal/kmod-wemo-gpio/src/Kconfig
```kconfig
config CONFIG_WEMO_GPIO
	tristate "Wemo GPIO driver"
	help
	  This is a customized Ralink GPIO driver for WeMO products.
```
